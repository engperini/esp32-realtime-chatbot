## sdkconfig.defaults
```kconfig
# ================= SYSTEM =================
CONFIG_ESP32S3_DEFAULT_CPU_FREQ_240=y
CONFIG_FREERTOS_HZ=1000

# ===== TARGET =====
CONFIG_IDF_TARGET="esp32s3"

# ===== FLASH SIZE (CORRETO PARA IDF 5.x) =====
CONFIG_ESPTOOLPY_FLASH_SIZE_8MB=y
CONFIG_ESPTOOLPY_FLASH_SIZE="8MB"



# ================= PSRAM ==================
CONFIG_SPIRAM=y
CONFIG_SPIRAM_MODE_OCT=y
CONFIG_SPIRAM_SPEED_80M=y
CONFIG_SPIRAM_ALLOW_STACK_EXTERNAL_MEMORY=y
CONFIG_SPIRAM_USE_CAPS_ALLOC=y

# ================= WIFI ===================
CONFIG_ESP_WIFI_STA_DISCONNECTED_PM_ENABLE=n

# ================= TLS ====================
CONFIG_MBEDTLS_CERTIFICATE_BUNDLE=y
CONFIG_MBEDTLS_CERTIFICATE_BUNDLE_DEFAULT_FULL=y

# ================= WEBSOCKET ==============
CONFIG_ESP_WEBSOCKET_CLIENT=y

# ================= I2S ====================
CONFIG_I2S_ENABLE_DEBUG_LOG=n

# ================= LVGL ===================
CONFIG_LVGL_USE_OS=y
CONFIG_LVGL_TICK_CUSTOM=y
CONFIG_LVGL_MEM_CUSTOM=y
CONFIG_LVGL_MEM_SIZE=65536
CONFIG_LVGL_USE_LOG=n

# ================= LOG ====================
CONFIG_LOG_DEFAULT_LEVEL_INFO=y

# ================= PARTITION TABLE =================
# CONFIG_PARTITION_TABLE_SINGLE_APP_LARGE=y
CONFIG_PARTITION_TABLE_CUSTOM=y
CONFIG_PARTITION_TABLE_CUSTOM_FILENAME="partitions.csv"
CONFIG_PARTITION_TABLE_FILENAME="partitions.csv"
CONFIG_PARTITION_TABLE_OFFSET=0x8000
CONFIG_PARTITION_TABLE_MD5=y
```
